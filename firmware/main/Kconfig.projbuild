## firmware/main/Kconfig.projbuild
```kconfig
menu "Futamaru"

    config FUTAMARU_RELAY_URL
        string "Relay WebSocket URL"
        default ""
        help
            サーバーの中継（relay）の URL（仕様 §3.2.1）。
            例: wss://<ホスト>/relay（Cloudflare Tunnel 経由）。手元の試験では ws://<PC の IP>:<ポート>/relay も使える。
            sdkconfig.secrets に書く。

    config FUTAMARU_DEVICE_KEY
        string "Device key for the relay"
        default ""
        help
            中継につなぐときの合言葉。HTTP ヘッダ「Authorization: Bearer <この値>」で送る。
            秘密情報なので sdkconfig.secrets に書く。

    config FUTAMARU_PLANT_ID
        string "Plant ID"
        default "a1"
        help
            どの株として話すか（start メッセージの plant_id）。
            英小文字・数字・_・- だけで 1〜32 文字。2 台目は b1 などに変える。

    config FUTAMARU_MULAW
        bool "Compress audio to the relay with mu-law"
        default y
        help
            中継との間の音を μ-law（G.711）で圧縮する（仕様 §3.2.1 の codec "mulaw"）。
            送る量が半分（32KB/秒 → 16KB/秒）になる。テザリングなど上りの細い回線でも途切れにくい
            （2026-11-19、iPhone のテザリングでは 16 ビットの PCM のままだと 1 割しか送れなかった）。
            n にすると 16 ビットの PCM のまま送る。

    config FUTAMARU_USE_AEC
        bool "Use echo cancellation (AEC)"
        default y
        help
            ES8311 がスピーカーに出した音（参照）をマイクの音と一緒に録り、
            植物自身の声をマイクの音から消す（仕様 §9 の 4）。
            うまく動かないときは n にして、サーバー側で割り込みを止める
            （docs/hardware/parts-selection.md）。

    config FUTAMARU_SPEAKER_VOLUME
        int "Speaker volume (0-100)"
        default 85
        range 0 100

    config FUTAMARU_MIC_GAIN_DB
        int "Microphone gain (dB)"
        default 30
        range 0 42
        help
            マイクの増幅。声が小さく聞き取られないときは上げ、割れるときは下げる。

    config FUTAMARU_STATUS_LED
        bool "Show status on the XIAO user LED (GPIO21)"
        default y

endmenu
```

## firmware/sdkconfig.defaults
```kconfig
# ふたまるのファームウェアの既定の設定（秘密情報は sdkconfig.secrets に書く）
CONFIG_IDF_TARGET="esp32s3"

#
# ふたまる（main/Kconfig.projbuild）
#
CONFIG_FUTAMARU_USE_AEC=y
CONFIG_FUTAMARU_SPEAKER_VOLUME=85
CONFIG_FUTAMARU_MIC_GAIN_DB=30
CONFIG_FUTAMARU_STATUS_LED=y

#
# Wi-Fi（livekit/example_utils）。切れても何度でもつなぎ直す
#
CONFIG_LK_EXAMPLE_USE_WIFI=y
CONFIG_LK_EXAMPLE_NETWORK_MAX_RETRIES=-1

#
# 中継（relay）との WebSocket（main/relay.c）
#
# wss:// のサーバーの証明書を、ESP-IDF 同梱の証明書の束で確かめる
CONFIG_MBEDTLS_CERTIFICATE_BUNDLE=y
CONFIG_MBEDTLS_CERTIFICATE_BUNDLE_DEFAULT_FULL=y
# TLS の作業場所を PSRAM に置き、内部 RAM を空けておく
CONFIG_MBEDTLS_EXTERNAL_MEM_ALLOC=y
# 送信（マイクの音）と受信（植物の声）が待ち合わないよう、送信用の鍵を分ける
CONFIG_ESP_WS_CLIENT_SEPARATE_TX_LOCK=y

#
# 録音・エコーキャンセル（esp_capture・esp-sr）と全体（esp_capture のサンプルと同じ）
#
CONFIG_COMPILER_OPTIMIZATION_PERF=y
CONFIG_FREERTOS_HZ=1000
CONFIG_IDF_EXPERIMENTAL_FEATURES=y
# 動画は使わない（ビルドを軽くする）
CONFIG_ESP_CAPTURE_ENABLE_VIDEO=n
CONFIG_PARTITION_TABLE_CUSTOM=y
CONFIG_PARTITION_TABLE_CUSTOM_FILENAME="partitions.csv"

#
# Seeed XIAO ESP32S3（Flash 8MB・Octal PSRAM 8MB）
#
CONFIG_ESP_DEFAULT_CPU_FREQ_MHZ_240=y
CONFIG_ESP32S3_DATA_CACHE_64KB=y
CONFIG_ESP32S3_DATA_CACHE_LINE_64B=y
CONFIG_ESP32S3_INSTRUCTION_CACHE_32KB=y
CONFIG_ESPTOOLPY_FLASHMODE_QIO=y
CONFIG_ESPTOOLPY_FLASHSIZE_8MB=y
CONFIG_SPIRAM=y
CONFIG_SPIRAM_MODE_OCT=y
CONFIG_SPIRAM_SPEED_80M=y
CONFIG_SPIRAM_FETCH_INSTRUCTIONS=y
CONFIG_SPIRAM_MALLOC_ALWAYSINTERNAL=256
CONFIG_SPIRAM_MALLOC_RESERVE_INTERNAL=8192
CONFIG_SPIRAM_TRY_ALLOCATE_WIFI_LWIP=y

# XIAO の USB-C は ESP32-S3 の USB（USB Serial/JTAG）に直結。ログはここに出す
CONFIG_ESP_CONSOLE_USB_SERIAL_JTAG=y

# esp_codec_dev は新しい I2C ドライバ（i2c_master）で使う。古いドライバと混ぜると起動時に止まる
CONFIG_CODEC_I2C_BACKWARD_COMPATIBLE=n
```
